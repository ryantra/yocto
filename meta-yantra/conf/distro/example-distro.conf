## meta-yantra/conf/distro/example-distro.conf
```bitbake
MAINTAINER = "ryantra <zoone.rupert@gmail.com>"

require conf/distro/poky.conf

DISTRO = "example-distro"
DISTRO_NAME = "example distro"
DISTRO_VERSION = "1.0"
DISTRO_CODENAME = "example"
SDK_VENDOR = "-exampledistro"
SDK_VERSION = "sdkversion"

# Set host name
hostname:pn-base-files = "ryantra"


# Remove sysvinit from DISTRO_FEATURES
#DISTRO_FEATURES_remove = "sysvinit"

# Add systemd to DISTRO_FEATURES
#DISTRO_FEATURES_append = "systemd"

# Set preffered provider for init_manager to systemd
#PREFERRED_PROVIDER_virtual/init_manager = "systemd"


# Set default timezone
DEFAULT_TIMEZONE = "Europe/Helsinki"
```

## meta-yantra/conf/layer.conf
```bitbake
# We have a conf and classes directory, add to BBPATH
BBPATH .= ":${LAYERDIR}"

# We have recipes-* directories, add to BBFILES
BBFILES += "${LAYERDIR}/recipes-*/*/*.bb \
            ${LAYERDIR}/recipes-*/*/*.bbappend"

BBFILE_COLLECTIONS += "meta-yantra"
BBFILE_PATTERN_meta-yantra = "^${LAYERDIR}/"
BBFILE_PRIORITY_meta-yantra = "6"

LAYERDEPENDS_meta-yantra = "core"
LAYERSERIES_COMPAT_meta-yantra = "dunfell"
```
